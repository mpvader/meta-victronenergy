## meta-bsp/conf/machine/container-amd64.conf
```bitbake
DEFAULTTUNE = "core2-64"
require conf/machine/include/x86/tune-core2.inc
require conf/machine/include/venus-container.inc
```

## meta-bsp/conf/machine/container-arm64.conf
```bitbake
DEFAULTTUNE = "cortexa53"
require conf/machine/include/arm/armv8a/tune-cortexa53.inc
require conf/machine/include/venus-container.inc
```

## meta-bsp/conf/machine/container-armv7.conf
```bitbake
DEFAULTTUNE = "cortexa8hf-neon"
require conf/machine/include/arm/armv7a/tune-cortexa8.inc
require conf/machine/include/venus-container.inc
```
